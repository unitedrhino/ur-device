## firmware/watcher/components/unitedrhino_iot_c_sdk/Kconfig
```kconfig
menu "UnitedRhino Iot C"
config UNITEDRHINO_IOT_C_SDK

    bool "UnitedRhino Iot C SDK."
    default "y"

endmenu
```

## firmware/watcher/components/unitedrhino_llsync/Kconfig
```kconfig
menu "UnitedRhino LLSync"
config UNITEDRHINO_LLSYNC_SUPPORT

    bool "UnitedRhino LLSync support."
    default "y"

endmenu
```
